## boards/shields/shoedler54/Kconfig.defconfig
```kconfig
if SHIELD_SHOEDLER54_LEFT

config ZMK_KEYBOARD_NAME
    default "shoedler54"

config ZMK_SPLIT_ROLE_CENTRAL
    default y

endif

if SHIELD_SHOEDLER54_LEFT || SHIELD_SHOEDLER54_RIGHT

config ZMK_SPLIT
    default y

endif
```

## zmk/boards/shields/shoedler54/Kconfig.shield
```kconfig
config SHIELD_SHOEDLER54_LEFT
    def_bool $(shields_list_contains,shoedler54_left)

config SHIELD_SHOEDLER54_RIGHT
    def_bool $(shields_list_contains,shoedler54_right)
```
